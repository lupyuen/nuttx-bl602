## drivers/rf/Kconfig
```kconfig
#
# For a description of the syntax of this configuration file,
# see the file kconfig-language.txt in the NuttX tools repository.
#

menuconfig DRIVERS_RF
	bool "RF Device Support"
	default n
	---help---
		Drivers for various RF devices

if DRIVERS_RF

config RF_DAT31R5SP
	bool "Mini-Circuits DAT-31R5-SP digital attenuator support"
	default n
	select SPI
	---help---
		Enable driver support for the Mini-Circuits DAT-31R5-SP digital
		attenuator.

config RF_SPI_TEST_DRIVER
	bool "SPI Test Driver"
	default n
	select SPI
	---help---
		Enable SPI Test Driver.

endif # DRIVERS_RF
```

## libs/librust/Kconfig
```kconfig
#
# For a description of the syntax of this configuration file,
# see the file kconfig-language.txt in the NuttX tools repository.
#

menuconfig LIBRUST
	bool "Rust Library"
	default n
	---help---
		Enable build for Rust Library

if LIBRUST

config LIBRUST_DEBUG
	bool "Rust Library debugging"
	default n
	---help---
		Enable debugging for Rust Library

endif # LIBRUST
```

## libs/libsx1262/Kconfig
```kconfig
#
# For a description of the syntax of this configuration file,
# see the file kconfig-language.txt in the NuttX tools repository.
#

menuconfig LIBSX1262
	bool "Digital Signal Processing Library"
	default n
	---help---
		Enable build for various DSP functions

if LIBSX1262

config LIBSX1262_DEBUG
	bool "Libsx1262 debugging"
	default n
	---help---
		Enable debugging for libsx1262. This option enables additional parameters
		checking. It can drastically reduce performance and be potentially
		dangerous to hardware, so it should be used carefully (probably only
		at an early stage of application development).

config LIBSX1262_PRECISION
	int "Libsx1262 precision [0/1/2]"
	default 0
	---help---
		With this option we can select libsx1262 precision for
		some of calculations. There are 3 available options:
		0 - the fastest calculation but the lowest precision,
		1 - increased precision than for option 0 at the expense
		    of a longer execution time,
		2 - the most accuracte but the slowest one, use standard math functions.

config LIBSX1262_FOC_VABC
	bool "Libsx1262 FOC includes voltage abc frame"

endif # LIBSX1262
```
